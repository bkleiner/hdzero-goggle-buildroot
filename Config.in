## Config.in
```kconfig
source "$BR2_EXTERNAL_HDZGOGGLE_PATH/package/hdzgoggle/Config.in"

source "$BR2_EXTERNAL_HDZGOGGLE_PATH/package/hdzero-tools/Config.in.host"
```

## configs/hdzgoggle_defconfig
```kconfig
BR2_arm=y
BR2_cortex_a7=y
BR2_ARM_FPU_NEON=y

# toolchain
BR2_TOOLCHAIN_EXTERNAL=y
BR2_TOOLCHAIN_EXTERNAL_CUSTOM=y
BR2_TOOLCHAIN_EXTERNAL_DOWNLOAD=y
BR2_TOOLCHAIN_EXTERNAL_URL="https://toolchains.bootlin.com/downloads/releases/toolchains/armv7-eabihf/tarballs/armv7-eabihf--musl--stable-2018.02-2.tar.bz2"
BR2_TOOLCHAIN_EXTERNAL_CUSTOM_PREFIX="arm-buildroot-linux-musleabihf"
BR2_TOOLCHAIN_EXTERNAL_REL_BIN_PATH="bin"
BR2_TOOLCHAIN_EXTERNAL_GCC_6=y
BR2_TOOLCHAIN_EXTERNAL_HEADERS_4_1=y
BR2_TOOLCHAIN_EXTERNAL_CUSTOM_MUSL=y
BR2_TOOLCHAIN_EXTERNAL_CXX=y

BR2_TARGET_GENERIC_HOSTNAME="hdzgoggle"
BR2_TARGET_GENERIC_ISSUE="HDZGOGGLE"

BR2_ENABLE_DEBUG=y
BR2_ENABLE_RUNTIME_DEBUG=y

#kernel
BR2_LINUX_KERNEL=y
BR2_LINUX_KERNEL_CUSTOM_GIT=y
BR2_LINUX_KERNEL_CUSTOM_REPO_URL="https://github.com/bkleiner/hdzero-goggle-linux.git"
BR2_LINUX_KERNEL_CUSTOM_REPO_VERSION="1a197517af68d08e99b2fcca91110c391be67b35"
BR2_LINUX_KERNEL_DEFCONFIG="hdzgoggle"
BR2_LINUX_KERNEL_UIMAGE=y
BR2_LINUX_KERNEL_LZO=y
BR2_LINUX_KERNEL_UIMAGE_LOADADDR="0X40008000"
BR2_LINUX_KERNEL_DTS_SUPPORT=y
BR2_LINUX_KERNEL_INTREE_DTS_NAME="hdzero_goggle"

#packages
BR2_PER_PACKAGE_DIRECTORIES=y
BR2_PACKAGE_LINUX_TOOLS_GPIO=y
BR2_PACKAGE_BUSYBOX_SHOW_OTHERS=y
BR2_PACKAGE_BUSYBOX_INDIVIDUAL_BINARIES=y
BR2_PACKAGE_GDB_SERVER=y
BR2_PACKAGE_BASH=y
BR2_PACKAGE_NANO=y
BR2_PACKAGE_HDZGOGGLE=y

# rootfs config
BR2_TARGET_ROOTFS_SQUASHFS=y
# BR2_TARGET_ROOTFS_TAR is not set

# Tools to build sdcard.img
BR2_PACKAGE_HOST_DOSFSTOOLS=y
BR2_PACKAGE_HOST_GENIMAGE=y
BR2_PACKAGE_HOST_MTOOLS=y
BR2_PACKAGE_HOST_DOS2UNIX=y
BR2_PACKAGE_HOST_HDZERO_TOOLS=y

BR2_ROOTFS_OVERLAY="$(BR2_EXTERNAL_HDZGOGGLE_PATH)/board/hdzgoggle/rootfs_overlay"
BR2_ROOTFS_POST_BUILD_SCRIPT="$(BR2_EXTERNAL_HDZGOGGLE_PATH)/board/hdzgoggle/post-build.sh"
BR2_ROOTFS_POST_IMAGE_SCRIPT="$(BR2_EXTERNAL_HDZGOGGLE_PATH)/board/hdzgoggle/post-image.sh"
```

## configs/hdzgoggle_sdcard_defconfig
```kconfig
BR2_arm=y
BR2_cortex_a7=y
BR2_ARM_FPU_NEON=y

# toolchain
BR2_TOOLCHAIN_EXTERNAL=y
BR2_TOOLCHAIN_EXTERNAL_CUSTOM=y
BR2_TOOLCHAIN_EXTERNAL_DOWNLOAD=y
BR2_TOOLCHAIN_EXTERNAL_URL="https://toolchains.bootlin.com/downloads/releases/toolchains/armv7-eabihf/tarballs/armv7-eabihf--musl--stable-2018.02-2.tar.bz2"
BR2_TOOLCHAIN_EXTERNAL_CUSTOM_PREFIX="arm-buildroot-linux-musleabihf"
BR2_TOOLCHAIN_EXTERNAL_REL_BIN_PATH="bin"
BR2_TOOLCHAIN_EXTERNAL_GCC_6=y
BR2_TOOLCHAIN_EXTERNAL_HEADERS_4_1=y
BR2_TOOLCHAIN_EXTERNAL_CUSTOM_MUSL=y
BR2_TOOLCHAIN_EXTERNAL_CXX=y
BR2_TOOLCHAIN_EXTERNAL_GDB_SERVER_COPY=y

BR2_TARGET_GENERIC_HOSTNAME="hdzgoggle"
BR2_TARGET_GENERIC_ROOT_PASSWD="hdzgoggle"

BR2_ENABLE_DEBUG=y
BR2_ENABLE_RUNTIME_DEBUG=y

#kernel
BR2_LINUX_KERNEL=y
BR2_LINUX_KERNEL_CUSTOM_GIT=y
BR2_LINUX_KERNEL_CUSTOM_REPO_URL="https://github.com/bkleiner/hdzero-goggle-linux.git"
BR2_LINUX_KERNEL_CUSTOM_REPO_VERSION="edb61f7c32c62a50aed814fca1edd2fda34180ac"
BR2_LINUX_KERNEL_DEFCONFIG="hdzgoggle"
BR2_LINUX_KERNEL_UIMAGE=y
BR2_LINUX_KERNEL_LZO=y
BR2_LINUX_KERNEL_UIMAGE_LOADADDR="0X40008000"
BR2_LINUX_KERNEL_DTS_SUPPORT=y
BR2_LINUX_KERNEL_INTREE_DTS_NAME="hdzero_goggle"

#packages
BR2_PER_PACKAGE_DIRECTORIES=y
BR2_ROOTFS_DEVICE_CREATION_DYNAMIC_MDEV=y
BR2_PACKAGE_BASH=y
BR2_PACKAGE_BUSYBOX_INDIVIDUAL_BINARIES=y
BR2_PACKAGE_BUSYBOX_SHOW_OTHERS=y
BR2_PACKAGE_GDB_SERVER=y
BR2_PACKAGE_HAVEGED=y
BR2_PACKAGE_HDZGOGGLE=y
BR2_PACKAGE_IW=y
BR2_PACKAGE_LINUX_TOOLS_GPIO=y
BR2_PACKAGE_NANO=y
BR2_PACKAGE_HTOP=y
BR2_PACKAGE_OPENSSH=y
BR2_PACKAGE_WPA_SUPPLICANT=y
BR2_PACKAGE_WPA_SUPPLICANT_AUTOSCAN=y
BR2_PACKAGE_WPA_SUPPLICANT_CLI=y
BR2_PACKAGE_WPA_SUPPLICANT_WPA_CLIENT_SO=y
BR2_PACKAGE_WPA_SUPPLICANT_CTRL_IFACE=y
BR2_PACKAGE_MTD=y
# BR2_PACKAGE_MTD_UBIHEALTHD is not set
BR2_PACKAGE_MTD_JFFS_UTILS=y
BR2_PACKAGE_MTD_MKFSJFFS2=y
BR2_PACKAGE_DOSFSTOOLS=y
BR2_PACKAGE_DOSFSTOOLS_FATLABEL=y
BR2_PACKAGE_DOSFSTOOLS_FSCK_FAT=y
BR2_PACKAGE_DOSFSTOOLS_MKFS_FAT=y
BR2_PACKAGE_EXFAT_UTILS=y

# Tools to build flash.img
BR2_PACKAGE_HOST_DOSFSTOOLS=y
BR2_PACKAGE_HOST_GENIMAGE=y
BR2_PACKAGE_HOST_MTOOLS=y
BR2_PACKAGE_HOST_DOS2UNIX=y
BR2_PACKAGE_HOST_HDZERO_TOOLS=y
BR2_PACKAGE_HOST_MTD=y

# rootfs config
BR2_TARGET_ROOTFS_EXT2=y
BR2_TARGET_ROOTFS_EXT2_4=y
BR2_TARGET_ROOTFS_EXT2_SIZE="512M"
# BR2_TARGET_ROOTFS_TAR is not set

BR2_ROOTFS_OVERLAY="$(BR2_EXTERNAL_HDZGOGGLE_PATH)/board/hdzgoggle_common/rootfs_overlay"
BR2_ROOTFS_POST_BUILD_SCRIPT="$(BR2_EXTERNAL_HDZGOGGLE_PATH)/board/hdzgoggle_common/post-build.sh $(BR2_EXTERNAL_HDZGOGGLE_PATH)/board/hdzgoggle_sdcard/post-build.sh"
BR2_ROOTFS_POST_IMAGE_SCRIPT="$(BR2_EXTERNAL_HDZGOGGLE_PATH)/board/hdzgoggle_common/post-image.sh $(BR2_EXTERNAL_HDZGOGGLE_PATH)/board/hdzgoggle_sdcard/post-image.sh"
```

## package/hdzero-tools/Config.in.host
```kconfig
config BR2_PACKAGE_HOST_HDZERO_TOOLS
	bool "host hdzero-tools"
	help
		tools to generate hdzero goggle images
```

## package/hdzgoggle/Config.in
```kconfig
config BR2_PACKAGE_HDZGOGGLE
	bool "hdzgoggle"
	help
		hdzero goggle application
	select BR2_PACKAGE_ALSA_UTILS
	select BR2_PACKAGE_ALSA_UTILS_AMIXER
```
